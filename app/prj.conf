## CMakeLists.txt
```
cmake_minimum_required(VERSION 3.20.0)
find_package(Zephyr REQUIRED HINTS $ENV{ZEPHYR_BASE})
project(swifi_framework)


target_sources(app PRIVATE src/main.c src/fi_msgq.c src/fi_core.c src/timer_fn.c src/fi_sem.c src/hook.c)
target_compile_options(app PRIVATE -Wmissing-field-initializers -Werror)
zephyr_link_libraries(-Wl,--wrap=main
                      -Wl,--wrap=z_impl_k_msgq_put
                      -Wl,--wrap=z_impl_k_sem_take)


                      
```

## Kconfig
```
mainmenu "SWIFI"


config FI_ENABLE
    bool "Abilita l'iniezione del fault"
    default y
config FI_VALUE
    hex "Valore corrotto assoluto"
    default 0x40
config FI_TRIGGER
    int "Attivazione su cui iniettare (fault transitorio)"
    default 1
config FI_TARGET
    int "Bersaglio dell'iniezione (numero T della campagna)"
    default 1
config FI_VERBOSE
    bool "Stampa una riga per ogni attivazione non iniettata"
    default y
config FI_MODE
    int "Modo di calcolo del valore corrotto (0=assoluto 1=relativo 2=random)"
    default 0
config FI_OFFSET
    int "Scostamento dal valore originale"
    default 0

choice
    prompt "Workload da eseguire"
    default WL_MSGQ
config WL_MSGQ
    bool "Code di messaggi"
config WL_SEM
    bool "Semafori"
endchoice

config WL_MSGQ_ISR
    bool "Produttore in contesto di interruzione (callback del timer)"
    depends on WL_MSGQ
    default n
    




source "Kconfig.zephyr" 
```

## prj.conf
```kconfig
# Abilita gli assert del kernel: serviranno a rilevare i parametri corrotti
# nella fase di iniezione (failure mode "assert-panic"). In una run pulito non scattano.




# gli scenari sovrascriveranno queste macro
CONFIG_FI_ENABLE=n
CONFIG_FI_VALUE=0x40
CONFIG_FI_TRIGGER=1
CONFIG_FI_TARGET=1
CONFIG_FI_VERBOSE=y

CONFIG_WL_SEM=y
```

## src/main.c
```c
#include "msgq_app.h"
#include <zephyr/kernel.h>
#include <string.h>
#include "sem_app.h"

#define MAX_MSGS 4
#define CANARY_BYTES 64
#define CANARY_PATTERN 0xAA
#define LIMIT 1
#define INITIAL_COUNT 1


// test per verificare l'utilizzo appropriato di k_magq_put nel contesto di interrupt
#ifdef CONFIG_WL_MSGQ_ISR


struct k_timer my_timer;

void my_expire_fn(struct k_timer *timer);


#endif







// K_MSGQ_DEFINE(my_msgq, sizeof(data_type), 4, 4);


/*
    Definiamo la coda a compile-time:
    my_msgq → nome della coda
    sizeof(data_type) → msg_size, quanti byte per messaggio
    4 → max_msgs, capacità massima della coda
    4 → allineamento del buffer
*/




// cambio di rotta: non utilizzo più la macro per definire la coda di messaggi + buffer perché ho bisogno di accedere al buffer per verificare
// buffer overflow quando CONFIG_ASSERT=n. Essendo che _k_fifo_buf_my_msgq (ring buffer creato dalla macro) è static, non posso accedere da inject.c direttamente
// perché static limita la visibilità all'esterno.
//
// Quindi devo necessariamente seguire il secondo approccio per inizializzare una coda di messaggi, ovvero quello di definire un ring_buffer e di utilizzare
// la funzione k_msgq_init(). Ovvero l'inizializzazione a runtime().
//
// L'idea è di aggiungere valori sentinella subito dopo il buffer per osservare il buffer-overflow

// inserisco il ring buffer della coda di messaggi e la sentinella (il buffer canary) all'interno di una struct in modo che in memoria siano
// disposti in modo contiguo, quindi un overflow su ring_buffer intacca il contenuto del buffer canary.

// CODE DI MESSAGGI




struct k_msgq my_msgq;

#ifdef CONFIG_WL_MSGQ

static struct{
    char ring_buffer[MAX_MSGS * sizeof(data_type)];
    uint8_t canary[CANARY_BYTES];
}area __aligned(__alignof__(data_type));

static void canary_fill(void){
    memset( area.canary, CANARY_PATTERN, CANARY_BYTES );
}

static void msgq_dump(const char *quando){

    // write_off è il dato chiave: deve essere compreso tra 0 e 15.
    // Il ring buffer è 16 byte = MAX_MSGS (4 messaggi) x sizeof(data_type) (4 byte ciascuno).
    // 
    printk("[CODA %s]\tused=%u,\t|\twrite_off=%d\t|\tread_off=%d\n",
        quando,
        my_msgq.used_msgs,
        (int)(my_msgq.write_ptr - my_msgq.buffer_start),
        (int)(my_msgq.read_ptr - my_msgq.buffer_start));
}


static void canary_check(const char *quando){
    unsigned int corrotti = 0;

    int primo = -1, ultimo = -1;

    for ( int i = 0; i < CANARY_BYTES; i++ ){
        if (area.canary[i] != CANARY_PATTERN ){
            corrotti++;
            if ( primo < 0 ) primo = i;
            ultimo = i;
        }
    }

    if ( corrotti == 0 ){
        printk("[CANARY %s] INTATTA: nessuna scrittura oltre il buffer\n", quando);
    }else{
        printk("[CANARY %s] CORROTTA: %u byte su %d, a partire dall'offset %d a %d\n",
                                        quando, corrotti, CANARY_BYTES, primo, ultimo);
    }
}


#endif


// SEMAFORI


#ifdef CONFIG_WL_SEM

K_SEM_DEFINE(my_sem, INITIAL_COUNT, LIMIT); // conteggio 1, limite 1 → mutex

static void sem_dump(const char *quando){

    printk("[SEM %s]\tcount=%u,\t|\tlimit=%u\n",
        quando,
        (unsigned)my_sem.count,
        (unsigned)my_sem.limit
    );

}

#endif


int main(void){
    #ifdef CONFIG_WL_MSGQ
    // inizializzazione della coda a run-time
    k_msgq_init(&my_msgq, area.ring_buffer, sizeof(data_type), MAX_MSGS);

    // riempiamo la sentinella con un valore riconoscibile come 0xAA
    canary_fill();


    data_type rx = { 0 };
    
    int ret;
    
    printk("\n\n--- SWIFI k_msgq: avvio ---\n");
    
    msgq_dump("iniziale");
    
    #ifndef CONFIG_WL_MSGQ_ISR 
    data_type tx = { .value = 42 };

    printk("\nPRODUTTORE\n");

    
    // PRODUTTORE: copia (memcpy) msg_size byte da &tx dentro la coda
    ret = k_msgq_put(&my_msgq, &tx, K_NO_WAIT);
    canary_check("after put#1");
    msgq_dump("after put#1");
    printk("put#1: ret=%d (inviato value=%u)\n", ret, tx.value);

    // ----------------------------------------------
    // SECONDA put dopo che lo stato della coda è corrotto. Abbiamo scritto al di fuori del ring_buffer

    data_type tx2 = { .value = 99 };
    ret = k_msgq_put(&my_msgq, &tx2, K_NO_WAIT);
    canary_check("after put#2");
    msgq_dump("after put#2");
    printk("put#2: ret=%d (inviato value=%u)\n", ret, tx2.value);

    // ----------------------------------------------


    printk("\nCONSUMATORE\n");
    
    // CONSUMATORE: copia (memcpy) msg_size byte dalla coda my_msgq in &rx

    ret = k_msgq_get(&my_msgq, &rx, K_NO_WAIT);

    printk("get#1: ret=%d (ricevuto value=%u)\n", ret, rx.value);

    canary_check("after get#1");
    msgq_dump("after get#1");



    // ----------------------------------------------
    // SECONDA get

    ret = k_msgq_get(&my_msgq, &rx, K_NO_WAIT);

    printk("get#2: ret=%d (ricevuto value=%u)\n", ret, rx.value);

    canary_check("after get#2");
    msgq_dump("after get#2");


    // ----------------------------------------------

    #endif

    #ifdef CONFIG_WL_MSGQ_ISR


    // check se sono in contesto interrupted

    printk("[MAIN] k_is_in_isr()=%d\n", k_is_in_isr());


    k_timer_init(&my_timer, my_expire_fn, NULL);


    k_timer_start(&my_timer, K_MSEC(5), K_NO_WAIT);

    k_timer_status_sync(&my_timer);

    // check della sentinel memory
    canary_check("after put#1");
    msgq_dump("after put#1");


    ret = k_msgq_get(&my_msgq, &rx, K_NO_WAIT);

    printk("get#1: ret=%d (ricevuto value=%u)\n", ret, rx.value);
    msgq_dump("after get#1");
    

    
    
    #endif



    // marcatore di fine run, aggiunto per discriminare i diversi failure mode
    // presente: WC
    // assente con panic: WA
    // assente senza panic: KH
    // senza twister non riesce a discriminare un workload completato da uno morto a metà.



    #endif

    #ifdef CONFIG_WL_SEM
    
    int r1 = k_sem_take(&my_sem, K_NO_WAIT);
    printk("sem_take#1: ret=%d\n", r1);
    sem_dump("after take#1");

    int r2 = k_sem_take(&my_sem, K_NO_WAIT);
    printk("sem_take#2: ret=%d\n", r2);
    sem_dump("after take#2");

    int r3 = k_sem_take(&my_sem, K_NO_WAIT);
    printk("sem_take#3: ret=%d\n", r3);

    sem_dump("after take#3");

    
    k_sem_give(&my_sem);
    sem_dump("after give#1");

    #endif

    
    
    printk("[RUN] END\n");
    return 0;
}
```

## src/activation_counter.c
```c
#include <zephyr/kernel.h>


static unsigned int calls_lock;
static unsigned int calls_take;
static unsigned int calls_give;
static unsigned int calls_start;
static unsigned int calls_sleep;


extern int __real_z_impl_k_mutex_lock(struct k_mutex * mutex, k_timeout_t timeout);

extern int __real_z_impl_k_sem_take(struct k_sem * sem, k_timeout_t timeout);

extern void __real_z_impl_k_sem_give(struct k_sem * sem);

extern void __real_z_impl_k_timer_start(struct k_timer * timer, k_timeout_t duration, k_timeout_t period);

extern int32_t __real_z_impl_k_sleep(k_timeout_t timeout);


void fi_report(void){
    printk("[INJECT] riepilogo: activations\nlock:%u\ntake:%u\ngive:%u\nstart:%u\nsleep:%u\n",
        calls_lock, calls_take, calls_give, calls_start, calls_sleep);   
}

int __wrap_z_impl_k_mutex_lock(struct k_mutex * mutex, k_timeout_t timeout){
    calls_lock++;
    return __real_z_impl_k_mutex_lock(mutex, timeout);
}

int __wrap_z_impl_k_sem_take(struct k_sem * sem, k_timeout_t timeout){
    calls_take++;
    return __real_z_impl_k_sem_take(sem, timeout);
}

void __wrap_z_impl_k_sem_give(struct k_sem * sem){
    calls_give++;
    __real_z_impl_k_sem_give(sem);
}

void __wrap_z_impl_k_timer_start(struct k_timer * timer, k_timeout_t duration, k_timeout_t period){
    calls_start++;
    __real_z_impl_k_timer_start(timer, duration, period);
}

int32_t __wrap_z_impl_k_sleep(k_timeout_t timeout){
    calls_sleep++;
    return __real_z_impl_k_sleep(timeout);
}
```

## src/fi_core.c
```c
#include "fi_core.h"
#include "zephyr/random/random.h"
#include <stdint.h>
#include <string.h>
#include <zephyr/kernel.h>

// Filtro sull'iniezione:
// Il metodo di Albinet applica il fault una sola volta e poi disabilità l'iniettore → per ricreare dei fault transitori e non permanenti.
// 
// Senza contatore, il modello di guasto non corrisponde ad un modello transitorio, in cui il fualt avviene una sola volta e si valuta come
// il kernel reagisce.
// 
// Introduco quindi un contatore, che a differenza di un booleano mi permette anche di decidere a quale attivazione dell'iniettore colpire
// quando l'oggetto corrisponde al target. Potrei quindi iniettare il fault alla prima, seconda, ... attivazione; questo permette di considerare diversi
// stati in cui si trova l'oggetto possa trovarsi.
// 

// CONFIG_FI_TRIGGER inietta alla N-esima attivazione sull'oggetto target
// CONFIG_FI_ENABLE abilita l'iniezione del fault
// CONFIG_FI_VALUE valore corrotto applicato al bersaglio

bool fi_core_attiva(unsigned int n_attivazione){
    if( !IS_ENABLED(CONFIG_FI_ENABLE) ){
        return false;
    }

    bool ret = n_attivazione == (unsigned int)CONFIG_FI_TRIGGER;
    #ifdef CONFIG_FI_VERBOSE
    if ( !ret )
        printk("[FI] attivazione #%u: nessuna iniezione\n", n_attivazione);
    #endif
    if ( ret )
        printk("[FI] contesto di esecuzione: %s\n", (k_is_in_isr()) ? "interrupt" : "thread");
    return ret;
}

static uintptr_t leggi(const void *oggetto, const fi_target_t *t){
    uintptr_t v = 0;
    memcpy(&v, (const char *)oggetto + t->offset, t->ampiezza);
    return v;
}

static void scrivi(void *oggetto, const fi_target_t *t, uintptr_t v){
    memcpy((char *)oggetto + t->offset, &v, t->ampiezza);
}

void fi_core_ripristina(void *oggetto, const fi_target_t *t, uintptr_t originale){
    if ( t->ripristino == FI_RIPRISTINA ){
        scrivi(oggetto, t, originale);
    }
}

fi_mode_t fi_core_mode(void){
    return (fi_mode_t)CONFIG_FI_MODE;
}

static uintptr_t fi_core_valore(const fi_target_t *t, uintptr_t originale){

    // (intptr_t) mi permette castare correttamente il valore con il segno 
    // (uintptr_t) poi ottengo il valore come uintptr_t → ottengo il complemento a 2

    switch ( fi_core_mode() ) {
        case FI_MODE_RELATIVO:
            return originale + (uintptr_t)(intptr_t)CONFIG_FI_OFFSET; 
        case FI_MODE_RANDOM:
            return (uintptr_t)sys_rand32_get();
        default:
            return (uintptr_t)CONFIG_FI_VALUE;
    
    }
}

// report pre e post iniezione
// 
static void fi_core_report_pre(const fi_target_t *t, uintptr_t originale, uintptr_t corrotto){
    printk("[FI] inject target=%s mode=%u orig=0x%08lx new=0x%08lx\n", t->nome, (unsigned)fi_core_mode(), (unsigned long)originale, (unsigned long)corrotto);
}
void fi_core_report_post(int ret){
    printk("[FI] done ret=%d\n", ret);
}
// -------------
// 

uintptr_t fi_core_applica(void *oggetto, const fi_target_t *t){
    uintptr_t original = leggi(oggetto, t);

    uintptr_t corrupted = fi_core_valore(t, original);

    scrivi(oggetto, t, corrupted);

    // report prima di ritornare, quindi prima della chiamata alla funzione reale
    // necessario per risolvere il problema con il MODE=2, perché la funzione fi_core_valore non è idempotente
    fi_core_report_pre(t, original, corrupted);

    return original;
}

void* fi_core_base(void *oggetto, void *const *parametri, size_t n, const fi_target_t *t){
    
    if ( t->luogo != FI_PARAMETRO ) return oggetto;
    
    if ( t->indice >= n ){
        printk("[FI] bersaglio %s: nessuna iniezione, parametro %u inesistente\n", t->nome, t->indice);
        return NULL;
    }
    return parametri[t->indice];
}




const fi_target_t *fi_core_bersaglio(const fi_target_t *tabella, size_t n){
    for ( size_t i = 0; i < n; i++ ){
        if ( tabella[i].id == CONFIG_FI_TARGET ){
            if ( tabella[i].ampiezza > sizeof(uintptr_t) || tabella[i].ampiezza == 0 ){
                printk("[FI] bersaglio %d: ampiezza %u non valida\n", CONFIG_FI_TARGET, (unsigned)tabella[i].ampiezza);
                return NULL;
            }
            return &tabella[i];
        }
    }
    printk("[FI] bersaglio %d non disponibile: nessuna iniezione\n", CONFIG_FI_TARGET);
    return NULL;
}

void fi_core_report_riepilogo(const char* nome_primitiva, unsigned int su_bersaglio, unsigned int su_altri){
    printk("[FI] riepilogo su %s: bersaglio=%u altri=%u\n", nome_primitiva, su_bersaglio, su_altri);
}
```

## src/fi_core.h
```c
#ifndef FI_CORE
#define FI_CORE

#include <stddef.h>
#include <stdint.h>
#include <stdbool.h>

// per discriminare come trattare il valore del bersaglio: su uno scalare uno scostamento è un numero, su un puntatore è aritmetica dei puntatori
typedef enum {FI_SCALARE, FI_PUNTATORE} fi_classe_t;

// per capire se necessario ripristinare il campo dopo la chiamata alla funzione reale.
// La regola da seguire: si ripristina SOLO se la funzione reale non modifica il campo di suo. Il ripristino rende transitorio il fault;
// su un campo che la funzione aggiorna cancellerebbe anche l'errore
typedef enum {FI_RIPRISTINA, FI_NON_RIPRISTINARE} fi_ripristino_t;

// specifica dove si trova il bersaglio: un campo di una struct dell'oggetto, oppure un parametro della chiamata
typedef enum {FI_CAMPO = 0, FI_PARAMETRO = 1} fi_luogo_t;

// specifica come calcolare il valore corrotto a partire dall'originale
typedef enum {
    FI_MODE_ASSOLUTO = 0,   // FI_VALUE
    FI_MODE_RELATIVO = 1,   // originale + FI_OFFSET → utilizzato per i puntatori
    FI_MODE_RANDOM = 2,     // valore estratto
} fi_mode_t;


// descrittore di un bersaglio, ovvero un CAMPO di una struct del kernel.
// specifica: dove si trova, quanto è grande e come si tratta. 
typedef struct {
    unsigned int id;
    const char *nome;
    size_t offset;
    size_t ampiezza;
    // La classe è presente ma non ancora letta da nessuna funzione: con la rappresentazione a uintptr_t
    // l'aritmetica su scalari e su puntatori coincide, quindi fi_core_valore non ha bisogno di distinguerli. 
    // Resta come documentazione del bersaglio
    fi_classe_t classe;
    fi_luogo_t luogo;
    unsigned int indice; // utile solo se luogo == FI_PARAMETRO, indica la posizione nella firma
    fi_ripristino_t ripristino;
} fi_target_t;


// necessaria per eseguire l'iniezione in una sola attivazione
bool fi_core_attiva(unsigned int n_attivazione);

// sostituisce il valore con quello corrotto
uintptr_t fi_core_applica(void *oggetto, const fi_target_t *t);
// ripristina il valore seguendo la regola spiegata sopra ↑

// permette di scegliere l'indirizzo base dell'iniezione: ha come risultato l'indirizzo del parametro, oppure l'indirizzo 
// della struct dell'oggetto
// ritorna NULL nel caso in cui è FI_PARAMETRO, ma l'indice non corrisponde a nessun parametro reale.
void* fi_core_base(void *oggetto, void *const *parametri, size_t n, const fi_target_t *t);

void fi_core_ripristina(void *oggetto, const fi_target_t *t, uintptr_t originale);


// report pre e post iniezione
void fi_core_report_post(int ret);
// --------

// cerca il bersaglio per id. NULL se non c'e'.
const fi_target_t *fi_core_bersaglio(const fi_target_t *tabella, size_t n);

void fi_core_report_riepilogo(const char* nome_primitiva, unsigned int su_bersaglio, unsigned int su_altri);



#endif
```

## src/fi_msgq.c
```c
#include <stdint.h>
#include <zephyr/kernel.h>
#include "msgq_app.h"
#include "fi_core.h"
#include "zephyr/sys/util_macro.h"

// Filtro sulla coda:
// --wrap è globale: il linker in questo momento devia tutte le chiamate dei moduli che dichiarano z_impl_k_msgq_put senza implementarla
// verso __wrap_z_impl_k_msgq_put (il wrapper). Significa che se un'altro modulo fa uso di una coda, corromperei anche quella.
// 
// Per localizzare il fault e renderlo controllabile allora dobbiamo far in modo che questo venga iniettato unicamente sull'utilizzo di una 
// coda di messaggi in specifico.
// 
// Dobbiamo realizzare un filtro che valuti l'identità di una coda, ovvero il suo indirizzo in memoria.
// 
// Essendo che my_msgq è definita in main.c, ovvero in un'altra unità di compilazione, la dichiaro extern in modo da fare una promessa 
// a compile-time che verrà soddisfatta dal linker successivamente.


static unsigned int fi_calls; // conta quante volte la coda bersaglio è stata utilizzata
// static a livello di file non modifica il ciclo di vita della variabile (rimane permanente, comportamento che otterei anche senza static)
// l'ho utilizzata solo per limitare la visibilità a livello di file; serve per non esportare il simbolo.


// SECONDO CONTATORE PER LE ATTIVAZIONI GLOBALI
// Serve a capire quali altri moduli oltre al mio utilizzano questa k_msgq_put.
static unsigned int fi_calls_other; // chiamate su altre code



// TABELLA dei bersagli
static const fi_target_t msgq_targets[] = {
    { .id = 1,
      .nome = "msg_size",
      .offset = offsetof(struct k_msgq, msg_size),
      .ampiezza = sizeof(size_t),
      .classe = FI_SCALARE,
      .ripristino = FI_RIPRISTINA,
	  .luogo = FI_CAMPO
	},

    { .id = 4,
      .nome = "max_msgs",
      .offset = offsetof(struct k_msgq, max_msgs),
      .ampiezza = sizeof(uint32_t),
      .classe = FI_SCALARE,
      .ripristino = FI_RIPRISTINA,
	  .luogo = FI_CAMPO
	},

    { .id = 5,
      .nome = "write_ptr",
      .offset = offsetof(struct k_msgq, write_ptr),
      .ampiezza = sizeof(char *),
      .classe = FI_PUNTATORE,
      .ripristino = FI_NON_RIPRISTINARE,
	  .luogo = FI_CAMPO 
	},   // <- la put lo avanza di suo

    { .id = 6,
      .nome = "buffer_start",
      .offset = offsetof(struct k_msgq, buffer_start),
      .ampiezza = sizeof(char *),
      .classe = FI_PUNTATORE,
      .ripristino = FI_RIPRISTINA,
	  .luogo = FI_CAMPO
	},

    { .id = 7,
      .nome = "buffer_end",
      .offset = offsetof(struct k_msgq, buffer_end),
      .ampiezza = sizeof(char *),
      .classe = FI_PUNTATORE,
      .ripristino = FI_RIPRISTINA,
	  .luogo = FI_CAMPO
	},

    { .id = 9,
      .nome = "read_ptr",
      .offset = offsetof(struct k_msgq, read_ptr),
      .ampiezza = sizeof(char *),
      .classe = FI_PUNTATORE,
      .ripristino = FI_RIPRISTINA,
	  .luogo = FI_CAMPO
	},

	{
		.id = 2,
		.nome = "data",
		.luogo = FI_PARAMETRO,
		.indice = 1,
		.offset = 0,
		.ampiezza = sizeof(const void *),
		.classe = FI_PUNTATORE,
		.ripristino = FI_NON_RIPRISTINARE
	},

	{
	    .id = 3,
		.nome = "timeout",
		.luogo = FI_PARAMETRO,
		.indice = 2,
		.offset = 0,
		.ampiezza = sizeof(uintptr_t),
		.classe = FI_SCALARE,
		.ripristino = FI_NON_RIPRISTINARE
	},
	
};

// con --wrap=z_impl_k_msgq_put il linker ci fornisce __real_z_impl_k_msgq_put come simbolo per la funzione originale.
extern int __real_z_impl_k_msgq_put(struct k_msgq *msgq, const void *data, k_timeout_t timeout);


void fi_msgq_report(void){
    fi_core_report_riepilogo("k_msgq_put", fi_calls, fi_calls_other);  
}


// ogni chiamata a k_msgq_put finisce qui.
int __wrap_z_impl_k_msgq_put(struct k_msgq *msgq, const void *data, k_timeout_t timeout){


    // FILTRO SULL'IDENTITÀ DELLA CODA 
    if ( msgq != &my_msgq ){
        // chiamo direttamente l'implementazione reale senza iniettare il fault
        fi_calls_other++;
        return __real_z_impl_k_msgq_put(msgq, data, timeout);
    }

    // incremento del contatore delle attivazione

    fi_calls++;

    if ( !fi_core_attiva(fi_calls) ){
        return __real_z_impl_k_msgq_put(msgq, data, timeout);
    }
    

    const fi_target_t *t = fi_core_bersaglio(msgq_targets, ARRAY_SIZE(msgq_targets));

    if ( t == NULL ){
        return __real_z_impl_k_msgq_put(msgq, data, timeout);
    }

	// array contenente gli argomenti nell'ordine della lista
	// necessario per identificare la base di un bersaglio di tipo parametro
	void *param_addr[] = { (void*)&msgq, (void*)&data, (void*)&timeout };

	void* base = fi_core_base(msgq, param_addr, ARRAY_SIZE(param_addr), t);

	if ( base == NULL ){
		return __real_z_impl_k_msgq_put(msgq, data, timeout);
	}

    
    uintptr_t original = fi_core_applica(base, t);
    
    int ret = __real_z_impl_k_msgq_put(msgq, data, timeout);

    // report post

    fi_core_ripristina(base, t, original);
    fi_core_report_post(ret);
    
    return ret;
}
```

## src/fi_sem.c
```c
#include "sem_app.h"
#include "fi_core.h"
#include <zephyr/kernel.h>

/*
 * Tale file contiene: la funzione da intercettare, l'oggetto da colpire e quali campi esistono
 * Non contiene log, logica di iniezione, il calcolo del valore corrotto e la conoscenza delle macro definite a tempo di compilazione
 * tutte queste proprietà fanno parte della parte comune del framework contenute in fi_core.c
 */


/*
 * __real_... Non esiste in nessun sorgente di Zephyr, lo crea il linker quando passiamo come flag -Wl,--wrap=z_impl... . Tale flag rinomina l'implementazione originale
 * in __real_... e devia tutte le chiamate al simbolo originale z_impl_... verso __wrap_z... .
 * 
 * Anche in questo caso non avremmo potuto wrappare k_sem_take perché nel sorgente è static inline → non genera un simbolo, a tempo di link questo simbolo non 
 * esiste perché a tempo di compilazione viene sostituita direttamente l'implementazione reale.
 * 
 */

extern int __real_z_impl_k_sem_take(struct k_sem *sem, k_timeout_t timeout);

static const fi_target_t sem_targets[] = {
    { .id=11, .nome="count", .offset=offsetof(struct k_sem, count), .ampiezza=sizeof(unsigned int), .classe=FI_SCALARE, .ripristino=FI_NON_RIPRISTINARE }, // take decrementa count → regola applicata
    { .id=12, .nome="limit", .offset=offsetof(struct k_sem, limit), .ampiezza=sizeof(unsigned int), .classe=FI_SCALARE, .ripristino=FI_RIPRISTINA }
};
/*
 * .id → il numero del bersaglio nella campagna
 * .nome → compare nel log
 * .offset → distanza in byte dall'inizio della struct per uno specifico campo
 * .ampiezza → quanti byte leggere e scrivere
 * .classe → presente ma non utilizzata, era necessaria a capire se stessimo trattando uno scalare (int) o un puntatore, quindi cambiava l'aritmetica da considerare
 * .ripristino → necessario per capire se un campo debba esser ripristinato a seguito dell'iniezione, la regola che ho imposto è: si ripristina solo se la funzione reale non modifica il campo di suo
 * 
 */

static unsigned int fi_calls;
static unsigned int fi_calls_other;

void fi_sem_report(void){
    fi_core_report_riepilogo("k_sem_take", fi_calls, fi_calls_other);
}

int __wrap_z_impl_k_sem_take(struct k_sem *sem, k_timeout_t timeout){
    // primo filtro sulla struttura dati

    /*
     * Questo primo filtro serve per garantire che l'iniezione avviene in una particolare attivazione del semaforo bersaglio.
     * Essendo --wrap globale: intercetta ogni chiamata a qual simbolo in tutta l'immagine, da qualunque modulo
     * 
     * Per garantire controllabilità è necessario che il fault sia localizzato su un solo oggetto
     * 
     * fi_calls_other mi permette di capire quanti altri moduli utilizzino questa primitiva su semafori che non sono il bersaglio
     * Su questo workload sintetico non esistono altri moduli che sfruttano semafori per sincronizzarsi, ma su uno reale non è detto che non esistino
     */
    
    if ( &my_sem != sem){
        fi_calls_other++;
        return __real_z_impl_k_sem_take(sem, timeout);
    }

    fi_calls++;

    if ( !fi_core_attiva(fi_calls) ){
        return __real_z_impl_k_sem_take(sem, timeout); 
    }

    const fi_target_t *t = fi_core_bersaglio(sem_targets, ARRAY_SIZE(sem_targets));

    if ( t == NULL ){
        return __real_z_impl_k_sem_take(sem, timeout);
    }

    void *param_addr[] = { (void*)&sem, (void*)&timeout };

    void* base = fi_core_base(sem, param_addr, ARRAY_SIZE(param_addr), t);

    if ( base == NULL ){
        return  __real_z_impl_k_sem_take(sem, timeout);
    }

    uintptr_t original = fi_core_applica(base, t);

    // chiamata all'implementazione reale
    int ret = __real_z_impl_k_sem_take(sem, timeout);

    // report post

    fi_core_ripristina(base, t, original);

    fi_core_report_post(ret);

    return ret;
}

/*
 * 
 * questo file è ciò che serve per estendere il framework a un nuovo oggetto del kernel: un wrapper e una tabella. Non contiene logica di iniezione, non stampa nulla
 * e non ha richiesto di modificare una riga della parte comune. 
 */
```

## src/hook.c
```c
extern int __real_main(void);
void fi_msgq_report(void);
void fi_sem_report(void);


int __wrap_main(void){
    int ret = __real_main();
    fi_msgq_report();
    fi_sem_report();

    

    return ret;
}
```

## src/inject.c
```c
#include <zephyr/kernel.h>
#include "msgq_app.h"
#include "zephyr/sys/util_macro.h"

// Filtro sulla coda:
// --wrap è globale: il linker in questo momento devia tutte le chiamate dei moduli che dichiarano z_impl_k_msgq_put senza implementarla
// verso __wrap_z_impl_k_msgq_put (il wrapper). Significa che se un'altro modulo fa uso di una coda, corromperei anche quella.
// 
// Per localizzare il fault e renderlo controllabile allora dobbiamo far in modo che questo venga iniettato unicamente sull'utilizzo di una 
// coda di messaggi in specifico.
// 
// Dobbiamo realizzare un filtro che valuti l'identità di una coda, ovvero il suo indirizzo in memoria.
// 
// Essendo che my_msgq è definita in main.c, ovvero in un'altra unità di compilazione, la dichiaro extern in modo da fare una promessa 
// a compile-time che verrà soddisfatta dal linker successivamente.


// Filtro sull'iniezione:
// Il metodo di Albinet applica il fault una sola volta e poi disabilità l'iniettore → per ricreare dei fault transitori e non permanenti.
// 
// Senza contatore, il modello di guasto non corrisponde ad un modello transitorio, in cui il fualt avviene una sola volta e si valuta come
// il kernel reagisce.
// 
// Introduco quindi un contatore, che a differenza di un booleano mi permette anche di decidere a quale attivazione dell'iniettore colpire
// quando la coda corrisponde al target. Potrei quindi iniettare il fault alla prima, seconda, ... put; questo permette di considerare diversi
// stati in cui si trova la coda (piena, vuota, piena a metà).
// 

// CONFIG_FI_TRIGGER inietta alla N-esima attivazione sulla coda target
// CONFIG_FI_ENABLE abilita l'iniezione del fault
// CONFIG_FI_VALUE valore corrotto scritto in msg_size

static unsigned int fi_calls; // conta quante volte la coda bersaglio è stata utilizzata
// static a livello di file non modifica il ciclo di vita della variabile (rimane permanente, comportamento che otterei anche senza static)
// l'ho utilizzata solo per limitare la visibilità a livello di file; serve per non esportare il simbolo.


// SECONDO CONTATORE PER LE ATTIVAZIONI GLOBALI
// Serve a capire quali altri moduli oltre al mio utilizzano questa k_msgq_put.
static unsigned int fi_calls_other; // chiamate su altre code






// con --wrap=z_impl_k_msgq_put il linker ci fornisce __real_z_impl_k_msgq_put come simbolo per la funzione originale.
extern int __real_z_impl_k_msgq_put(struct k_msgq *msgq, const void *data, k_timeout_t timeout);


void fi_report(void){
    printk("[INJECT] riepilogo: coda bersaglio=%u, altre code=%u\n",
                                                fi_calls, fi_calls_other);   
}


// ogni chiamata a k_msgq_put finisce qui.
int __wrap_z_impl_k_msgq_put(struct k_msgq *msgq, const void *data, k_timeout_t timeout){

    //printk("[INJECT] intercettata k_msgq_put (msg_size=%u), max_msgs=%d\n", (unsigned)msgq->msg_size, msgq->max_msgs);

    // FILTRO SULL'IDENTITÀ DELLA CODA 
    if ( msgq != &my_msgq){
        // chiamo direttamente l'implementazione reale senza iniettare il fault
        fi_calls_other++;
        return __real_z_impl_k_msgq_put(msgq, data, timeout);
    }

    // incremento del contatore delle attivazione

    fi_calls++;

    if ( !IS_ENABLED(CONFIG_FI_ENABLE) ){
        return __real_z_impl_k_msgq_put(msgq, data, timeout);
    }

    
    // se non è l'attivazione scelta, vado direttamente a chiamare l'implementazione reale
    if ( fi_calls != (unsigned int)CONFIG_FI_TRIGGER){
        printk("[INJECT] attivazione #%u: nessuna iniezione\n", fi_calls);
        return __real_z_impl_k_msgq_put(msgq, data, timeout);
    }

    
    size_t original_size = msgq->msg_size;
    size_t corrupted_size = (size_t)CONFIG_FI_VALUE;
    // reale =4; con 64 (default) la memcpy copia 64 byte → overflow


    printk("[INJECT] msg_size=%u -> %u (corrupted)\n", original_size, corrupted_size);

    
    msgq->msg_size = corrupted_size; // FAULT
    int ret = __real_z_impl_k_msgq_put(msgq, data, timeout); // atteso un overflow
    msgq->msg_size = original_size; // ripristino dopo il fault altrimenti in modo che la get legga sempre 4byte

    printk("[INJECT] put ret=%d (dopo la corruzione)\n", ret);
    return ret;
}
```

## src/msgq_app.h
```c
#ifndef MSGQ_APP_H
#define MSGQ_APP_H


#include <zephyr/kernel.h>


// tipo di dato che viaggia nella coda: un elemento a dimensione fissa
typedef struct data{
    uint32_t value;
} data_type;

extern struct k_msgq my_msgq;

#endif
```

## src/sem_app.h
```c
#ifndef SEM_APP_H
#define SEM_APP_H


#include <zephyr/kernel.h>



extern struct k_sem my_sem;

#endif
```

## src/timer_fn.c
```c
#include <string.h>
#include <zephyr/kernel.h>
#include "msgq_app.h"



void my_expire_fn(struct k_timer *timer){
    printk("[TIMER] timer expired, status=%u\n", k_timer_status_get(timer));


    
    
    printk("[TIMER] k_is_in_isr()=%d\n", k_is_in_isr());
    

    // creo il messaggio data_type con calore riconoscibile
    data_type tx = { .value=100 };

    int ret = k_msgq_put(&my_msgq, &tx, K_NO_WAIT);
    printk("put#1: ret=%d (inviato value=%u)\n", ret, tx.value);

    printk("[TIMER] expired_fn terminated\n");
}
```
